## config/boards/shields/36key/Kconfig.defconfig
```kconfig
# Copyright (c) 2022 The ZMK Contributors
# SPDX-License-Identifier: MIT

if SHIELD_36KEY_LEFT

config ZMK_KEYBOARD_NAME
  default "36Key"

config ZMK_SPLIT_ROLE_CENTRAL
	default y

endif

if SHIELD_36KEY_LEFT || SHIELD_36KEY_RIGHT

config ZMK_SPLIT
	default y

endif
```

## config/boards/shields/36key/Kconfig.shield
```kconfig
# Copyright (c) 2022 The ZMK Contributors
# SPDX-License-Identifier: MIT

config SHIELD_36KEY_LEFT
   def_bool $(shields_list_contains,36key_left)

config SHIELD_36KEY_RIGHT
   def_bool $(shields_list_contains,36key_right)
```

## config/boards/shields/8keytoy/Kconfig.defconfig
```kconfig
# Copyright (c) 2022 The ZMK Contributors
# SPDX-License-Identifier: MIT

if SHIELD_8KEYTOY_LEFT

config ZMK_KEYBOARD_NAME
  default "8KeyToy"

config ZMK_SPLIT_ROLE_CENTRAL
	default y

endif

if SHIELD_8KEYTOY_LEFT || SHIELD_8KEYTOY_RIGHT

config ZMK_SPLIT
	default y

endif
```

## config/boards/shields/8keytoy/Kconfig.shield
```kconfig
# Copyright (c) 2022 The ZMK Contributors
# SPDX-License-Identifier: MIT

config SHIELD_8KEYTOY_LEFT
   def_bool $(shields_list_contains,8keytoy_left)

config SHIELD_8KEYTOY_RIGHT
   def_bool $(shields_list_contains,8keytoy_right)
```
